## config/boards/shields/klink_kbd/Kconfig.defconfig
```kconfig
# Copyright (c) 2020 The ZMK Contributors
# SPDX-License-Identifier: MIT

# all use the same settings. remove #if

config ZMK_KEYBOARD_NAME
    default "agar_ble"

config LED
    default y
```

## config/boards/shields/klink_kbd/Kconfig.shield
```kconfig
# Copyright (c) 2020 The ZMK Contributors
# SPDX-License-Identifier: MIT

config SHIELD_AGAR_BLE
    def_bool $(shields_list_contains,agar_ble)
```

## config/boards/shields/klink_kbd/boards/klink.conf
```kconfig
# All config for this keyboard
CONFIG_BUILD_OUTPUT_UF2_FAMILY_ID="0x59952840"

CONFIG_SPI=y

#USB
CONFIG_ZMK_USB=y
CONFIG_USB_DEVICE_VID=0x9D5B
CONFIG_USB_DEVICE_PID=0x2565
CONFIG_USB_DEVICE_MANUFACTURER="KBDFans"
CONFIG_ZMK_KEYBOARD_NAME="Agar BLE (USB)"

#BLE
CONFIG_ZMK_BLE=y
CONFIG_BT_DEVICE_NAME_MAX=23
CONFIG_BT_DEVICE_NAME="Agar BLE"
CONFIG_ZMK_BLE_EXPERIMENTAL_CONN=y
CONFIG_BT_CTLR_TX_PWR_PLUS_8=y
CONFIG_ZMK_IDLE_TIMEOUT=30000
#CONFIG_ZMK_SLEEP=y
#CONFIG_ZMK_IDLE_SLEEP_TIMEOUT=12000000

#
CONFIG_ZMK_HID_CONSUMER_REPORT_USAGES_FULL=y
CONFIG_ZMK_HID_GENERIC_DESKTOP_USAGES_BASIC=y
CONFIG_ZMK_POINTING=y
CONFIG_ZMK_HID_INDICATORS=y

CONFIG_ZMK_KSCAN_DEBOUNCE_PRESS_MS=3
CONFIG_ZMK_KSCAN_DEBOUNCE_RELEASE_MS=5

#CONFIG_ZMK_STUDIO=y
CONFIG_ZMK_STUDIO_LOCKING=n
CONFIG_ZMK_STUDIO_LOCK_ON_DISCONNECT=n

# No RGB, remove this, one less option to show on zmk studio.
CONFIG_ZMK_EXT_POWER=n
CONFIG_ZMK_PM_SOFT_OFF=y
# If there is RGB, enable the following three.
#CONFIG_ZMK_RGB_UNDERGLOW=y
#CONFIG_WS2812_STRIP=y
#CONFIG_ZMK_RGB_UNDERGLOW_AUTO_OFF_IDLE=y
```

## config/west.yml
```yaml
manifest:
  remotes:
    - name: zmkfirmware
      url-base: https://github.com/zmkfirmware
    - name: yangdigi
      url-base: https://github.com/yangdigi
    # Additional modules containing boards/shields/custom code can be listed here as well
    # See https://docs.zephyrproject.org/3.2.0/develop/west/manifest.html#projects
  projects:
    - name: zmk
      remote: yangdigi
      revision: main
      import: app/west.yml
    - name: zmk-keyboards-klink
      remote: yangdigi
      revision: main
  self:
    path: config
```
